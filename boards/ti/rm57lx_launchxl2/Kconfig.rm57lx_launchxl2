## boards/ti/rm57lx_launchxl2/Kconfig.rm57lx_launchxl2
```kconfig
# TI RM57Lx LaunchXL2 board

# Copyrights (c) 2024 Rahul Arasikere <arasikere.rahul@gmail.com>
# SPDX-License-Identifier: Apache-2.0

config BOARD_RM57LX_LAUNCHXL2
    select SOC_RM57L843ZWT
```

## boards/ti/rm57lx_launchxl2/board.yml
```yaml
# Copyrights (c) 2024 Rahul Arasikere <arasikere.rahul@gmail.com>
# SPDX-License-Identifier: Apache-2.0

board:
  name: rm57lx_launchxl2
  vendor: ti
  socs:
  - name: rm57l843zwt
```

## boards/ti/rm57lx_launchxl2/rm57lx_launchxl2_defconfig
```kconfig
# Copyrights (c) 2024 Rahul Arasikere <arasikere.rahul@gmail.com>
# SPDX-License-Identifier: Apache-2.0

CONFIG_BUILD_OUTPUT_HEX=y

# 300 MHz sys clock
CONFIG_SYS_CLOCK_HW_CYCLES_PER_SEC=300000000
```

## drivers/clock_control/Kconfig.ti_hercules
```kconfig
# Copyright 2024 (c) Rahul Vagish Arasikere <arasikere.rahul@gmail.com>
# SPDX-License-Identifier: Apache-2.0


menuconfig CLOCK_CONTROL_TI_HERCULES
    bool "TI Hercules Global Clock Module"
    default y
    depends on SOC_FAMILY_TI_HERCULES
    help
      Enable driver for the Global Clock Module (GCM) found in the TI Hercules family of MCUs

if CLOCK_CONTROL_TI_HERCULES


endif # CLOCK_CONTROL_TI_HERCULES
```

## drivers/gpio/Kconfig.hercules
```kconfig
# Copyright (c) 2024 Rahul Arasikere <arasikere.rahul@gmail.com>
# SPDX-License-Identifier: Apache-2.0

config GPIO_HERCULES
	bool "TI Hercules GIO driver"
	default y
	depends on DT_HAS_TI_HERCULES_GIO_ENABLED
	help
	  Enable the TI Hercules GIO driver.
```

## drivers/mdio/Kconfig.stm32
```kconfig
# SPDX-License-Identifier: Apache-2.0

config MDIO_STM32
	bool "ST STM32 MDIO driver"
	depends on ETH_STM32_HAL
	default y
	help
	  Enable ST STM32 Family Ethernet based MDIO driver.
```

## drivers/mfd/Kconfig.pf15xx
```kconfig
# Copyright (c) 2024 Rahul Arasikere
# SPDX-License-Identifier: Apache-2.0

config MFD_NXP_PF15XX
	bool "NXP PF15XX PMIC multi-function device driver"
	default y
	depends on DT_HAS_NXP_PF15XX_ENABLED
	select I2C
	select GPIO
	help
	  Enable the NXP PF15XX PMIC multi-function device driver
```

## drivers/regulator/Kconfig.pf1550
```kconfig
# Copyrights 2024 Rahul Arasikere <arasikere.rahul@gmail.com>
# SPDX-License-Identifier: Apache-2.0

config REGULATOR_PF1550
    bool "PF1550 PMIC regulator driver"
    default y
    depends on DT_HAS_NXP_PF1550_REGULATOR_ENABLED
    select I2C
    select MFD
    help
      Enable the NXP PF1550 PMIC regulator driver

if REGULATOR_PF1550

config REGULATOR_NXP_PF1550_COMMON_INIT_PRIORITY
	int "MAX20335 regulator driver init priority (common part)"
	default 86
	help
	  Init priority for the NXP PF1550 regulator driver
	  (common part). It must be greater than I2C and MFD init priority.

config REGULATOR_NXP_PF1550_INIT_PRIORITY
	int "MAX20335 regulator driver init priority"
	default 87
	help
	  Init priority for the NXP PF1550 regulator driver. It must be
	  greater than REGULATOR_NXP PF1550_COMMON_INIT_PRIORITY

endif # REGULATOR_PF1550
```

## drivers/regulator/Kconfig.pf15xx
```kconfig
# Copyrights 2024 Rahul Arasikere <arasikere.rahul@gmail.com>
# SPDX-License-Identifier: Apache-2.0

config REGULATOR_PF15XX
    bool "PF15XX PMIC regulator driver"
    default y
    depends on DT_HAS_NXP_PF15XX_REGULATOR_ENABLED
    select I2C
    select MFD
    help
      Enable the NXP PF15XX PMIC regulator driver

if REGULATOR_PF15XX

config REGULATOR_NXP_PF15XX_COMMON_INIT_PRIORITY
	int "MAX20335 regulator driver init priority (common part)"
	default 86
	help
	  Init priority for the NXP PF15XX regulator driver
	  (common part). It must be greater than I2C and MFD init priority.

config REGULATOR_NXP_PF15XX_INIT_PRIORITY
	int "MAX20335 regulator driver init priority"
	default 87
	help
	  Init priority for the NXP PF15XX regulator driver. It must be
	  greater than REGULATOR_NXP PF15XX_COMMON_INIT_PRIORITY

endif # REGULATOR_PF15XX
```

## drivers/timer/Kconfig.ti_hercules_rti_timer
```kconfig
# Copyrights 2024 Rahul Arasikere <arasikere.rahul@gmail.com>
# SPDX-License-Identifier: Apache-2.0

config TI_HERCULES_RTI_TIMER
	bool "TI Hercules Real Time Interrupt Driver"
	default y
	depends on DT_HAS_TI_HERCULES_RTI_TIMER_ENABLED
	select TICKLESS_CAPABLE
	select TIMER_HAS_64BIT_CYCLE_COUNTER
	help
	  This module implements a kernel device driver for the TI Hercules series Real Time Interrupt module and provides the standard "system clock driver" interfaces.
```

## dts/bindings/clock/ti,hercules-gcm.yaml
```yaml
# Copyright (c) 2024, Rahul Vagish Arasikere <arasikere.rahul@gmail.com>
# SPDX-License-Identifier: Apache-2.0

include: [base.yaml, clock-controller.yaml]

compatible: "ti,hercules-gcm"

description: |
  TI Hercules Global Clock Module.

  This node enables the GCM module drivers.

properties:
  '#clock-cells':
    const: 2

  bypass-on-pll-slip:
    type: boolean
    description: |
      Switch over to oscillator on PLL slip.
      Applies only to PLL1.

  reset-on-pll-slip:
    type: boolean
    description: |
      Automatically reset CPU on PLL slip.
      Applies only to PLL1.

  reset-on-oscillator-fail:
    type: boolean
    description: |
      Automatically reset CPU on an oscillator failure.
      Applies only to PLL1.

  enable-freq-modulation:
    type: boolean
    description: |
      Enable frequency modulation on PLL.
      Applies only to PLL1.


clock-cells:
  - clock-domain
  - flags
  
```

## dts/bindings/clock/ti,hercules-lpo-clock.yaml
```yaml
# Copyright (c) 2024, Rahul Arasikere <arasikere.rahul@gmail.com>
# SPDX-License-Identifier: Apache-2.0

description: TI Hercules LPO Clock Controller

compatible: "ti,hercules-lpo-clock"

include: [clock-controller.yaml, base.yaml]

properties:

  set-trim-from-otp:
    type: boolean
    description: |
      Sets the trim values from flash OTP.
  
  enable-lpo-bias:
    type: boolean
    description: |
      Enable the current source which drives the LPO.

  trim:
    type: int
    description: |
      Trim value for LPO. Ranges from 0 to 31 which set the corresponding 5 bits in the LPO registers.

  "#clock-cells":
    const: 0
```

## dts/bindings/clock/ti,hercules-pll-clock.yaml
```yaml
# Copyright (c) 2024, Rahul Arasikere <arasikere.rahul@gmail.com>
# SPDX-License-Identifier: Apache-2.0

description: |
  TI Hercules PLL Clock Controller

  PLL takes an input of OSCIN, EXTCLKIN1 or EXTCLKIN2 as the input clock.

  Frequency calculation for the output is as follows:

  f(PLL) = f(IN_CLK) / NR * NF * 1 / OD * 1/ R

compatible: "ti,hercules-pll-clock"

include: [clock-controller.yaml, base.yaml]

properties:
  "#clock-cells":
    const: 0

  clocks:
    required: true

  nr:
    type: int
    required: true
    description: |
      Configurable prescale divider (NR) for the input clock. Ranges between 1 to 64.

  nf:
    type: int
    required: true
    description: |
      Configurable multiplier (NF) for the input clock. Ranges between 1 to 256.

  od:
    type: int
    required: true
    description: |
      Configurable postscale divider (OD). Ranges between 1 to 8.
    enum:
      - 1
      - 2
      - 3
      - 4
      - 5
      - 6
      - 7
      - 8

  r:
    type: int
    required: true
    description: |
      Configurable postscale divider (R). Ranges between 1 to 32.

  ns:
    type: int
    description: |
      Configurable modulation frequency.
      Applies only to PLL1. Ranges between 1 to 512.

  nv:
    type: int
    description: |
      Configurable modulation depth.
      Applies only to PLL1. Ranges between 1 to 512.

  mulmod:
    type: int
    description: |
      Multipler correction for PLL1 when frequency modulations is enabled. Ranges between 8 to 511.
```

## dts/bindings/ethernet/ti,dp83td510e.yaml
```yaml
# Copyrights 2024 Rahul Arasikere <arasikere.rahul@gmail.com>
# SPDX-License-Identifier: Apache-2.0

description: TI DP83TD510E Ethernet PHY

compatible: "ti,dp83td510e"

include: 
  - name: ethernet-phy.yaml

properties:
  low-power-mode:
    type: boolean
    description: |
      Enable the RMII Master Low Power Mode. The interface is similar to the
      RMII master mode but runs at 5 MHz resulting in power dissipation savings.
  reset-gpios:
    type: phandle-array
    description: GPIO connected to PHY reset signal pin. Reset is active low.
  use-pwdn-as-interrupt:
    type: boolean
    description: Use the PWDN GPIO as an interrupt. Requires register access.
  int-pwdn-gpios:
    type: phandle-array
    description: GPIO to put the PHY in power down mode / interrupt pin.
  use-rmii-rev-1-2:
    type: boolean
    description: Operate in RMII rev 1.2 mode over rev 1.1.
  max-tx-rx-p2p-microvolt:
    description: Configures the Tx/Rx p2p differential output voltage for 10base-T1L PHYs.
    type: string
    enum:
      - "1100"
      - "2400"
      - "auto"
    default: "auto"
  mac-connection-type:
    type: string
    description: |
      Specifies the interface connection type between PHY MAC and ethernet MAC.
    enum:
      - "mii"
      - "rmii_master"
      - "rmii_slave"
      - "rgmii"
      - "rmii_master_low_power"
      - "rmii_extender"
```

## dts/bindings/gpio/ti,hercules-gio.yaml
```yaml
# Copyrights (c) 2024 Rahul Arasikere <arasikere.rahul@gmail.com
# SPDX-License-Identifier: Apache-2.0

description: TI Hercules series GIO port binding.

include: [gpio-controller.yaml, base.yaml]

properties:
  reg:
    required: true

  "#gpio-cells":
    const: 2

gpio-cells:
  - pin
  - flags
```

## dts/bindings/mdio/st,stm32-mdio.yaml
```yaml
# Copyright (c) 2023 Rahul Arasikere
# SPDX-License-Identifier: Apache-2.0

description: ST STM32 Family MDIO Driver node

compatible: "st,stm32-mdio"

include:
  - name: mdio-controller.yaml
  - name: pinctrl-device.yaml
```

## dts/bindings/mfd/nxp,pf1550.yaml
```yaml
# Copyright (c) 2024 Rahul Arasikere <arasikere.rahul@gmail.com>
# SPDX-License-Identifier: Apache-2.0

description: NXP PF1550

compatible: "nxp,pf1550"

include: i2c-device.yaml

properties:
  reg:
    required: true

  enable-watchdog:
    description: Chip has watchdog input from the processor.
    type: boolean

  standby-pin:
    description: STANDBY input.
    type: phandle
```

## dts/bindings/mfd/nxp,pf15xx.yaml
```yaml
# Copyright (c) 2024 Rahul Arasikere <arasikere.rahul@gmail.com>
# SPDX-License-Identifier: Apache-2.0

description: NXP PF15XX

compatible: "nxp,pf15xx"

include: i2c-device.yaml

properties:
  reg:
    required: true

  enable-watchdog:
    description: Chip has watchdog input from the processor.
    type: boolean

  standby-gpios:
    description: STANDBY input.
    type: phandle-array
```

## dts/bindings/pinctrl/ti,hercules-iomm.yaml
```yaml
# Copyright (c) 2024 Rahul Arasikere <arasikere.rahul@gmail.com>
# SPDX-License-Identifier: Apache-2.0

# This binding implements the required configuration features for the RM57Lx IOMM module as described in Chapter 6 of the TRM.

description: |
  The TI Hercules series safety processor include a I/O Multiplexing and Control Module (IOMM)
  to control and enable the multiplexing of pins. It consists of memory mapped
  registers to  configure individual pins alongs side a kicker to protect write
  access to the pins with error indication.

  Here is a list of supported standard pin properties:

    - drive-push-pull: Push-pull drive mode (default, not required).
    - drive-open-drain: Open-drain drive mode.
    - bias-disable: Disable pull-up/down (default, not required).
    - bias-pull-up: Enable pull-up resistor.
    - bias-pull-down: Enable pull-down resistor.
    - output-enable: Enable output for the pin
    - output-high: Enable high output.
    - output-low: Enable low output. (default not required)

compatible: "ti,hercules-iomm"

include: base.yaml

properties:
  reg:
    required: true
    description: |
      Base address and size of the memory mapped registers of the IOMM.
  
child-binding:
  description: |
    RM57Lx Pin Configuration node.

  include: 
    - name: pincfg-node.yaml
      property-allowlist:
        - drive-push-pull
        - drive-open-drain
        - bias-disable
        - bias-pull-up
        - bias-pull-down
        - output-high
        - output-low
        - output-enable

  properties:
    pinmux:
      required: true
      type: int
      description: |
        Defines the alternate function this pin maps to.
        It accepts an integer array representing gpio pin number 
        and mux setting

        With:
          - Byte offset to where byte is located to control the ball.
          - Alternate function to map to:
            0: Default Function
            1: Alternate Function 1 (if available)
            2: Alternate Function 2 (if available)
            ...
            5: Alternate Function 5 (if available)
          In case multiple bits are set, the hardware uses the default function.
          Other functionality can be set using the generic pincfg-node 
          boolean values.
    
```

## dts/bindings/timer/ti,hercules-rti-timer.yaml
```yaml
# Copyright (c) 2024 Rahul Arasikere <arasikere.rahul@gmail.com>
# SPDX-License-Identifier: Apache-2.0

description: TI Hercules RTI Timer Node

compatible: "ti,hercules-rti-timer"

include: base.yaml

properties:
  reg:
    required: true

  interrupts:
    required: true
```

## soc/ti/hercules/Kconfig
```kconfig
# Texas Instruments Hercules Family
# SPDX-License-Identifier: Apache-2.0
# Copyright (c) 2024 Rahul Arasikere <arasikere.rahul@gmail.com>

if SOC_FAMILY_TI_HERCULES

rsource "*/Kconfig"

endif # SOC_FAMILY_TI_HERCULES
```

## soc/ti/hercules/Kconfig.soc
```kconfig
# Texas Instruments Hercules Family
# SPDX-License-Identifier: Apache-2.0
# Copyright (c) 2024 Rahul Arasikere <arasikere.rahul@gmail.com>

config SOC_FAMILY_TI_HERCULES
    bool

config SOC_FAMILY
    default "ti_hercules" if SOC_FAMILY_TI_HERCULES

rsource "*/Kconfig.soc"
```

## soc/ti/hercules/rm57lx/Kconfig
```kconfig
# Texas Instruments Hercules RM57Lx
# Copyright (c) 2024 Rahul Arasikere <arasikere.rahul@gmail.com>
# SPDX-License-Identifier: Apache-2.0

config SOC_SERIES_RM57LX
    select ARM
    select CPU_CORTEX_R5
    select CPU_HAS_MPU
    select VFP_DP_D16
    select HWINFO
    select DYNAMIC_INTERRUPTS
	select CPU_HAS_DCLS
	select CPU_HAS_ARM_MPU
    select CPU_HAS_DSP
    select CPU_HAS_DCACHE
    select CPU_HAS_ICACHE
    select PLATFORM_SPECIFIC_INIT
    select CLOCK_CONTROL
    select ARM_CUSTOM_INTERRUPT_CONTROLLER
```

## soc/ti/hercules/rm57lx/Kconfig.defconfig
```kconfig
# Texas Instruments Hercules RM57Lx
# Copyright (c) 2024 Rahul Arasikere <arasikere.rahul@gmail.com>
# SPDX-License-Identifier: Apache-2.0

if SOC_SERIES_RM57LX

config NUM_IRQS
    default 128

DT_CHOSEN_Z_FLASH := zephyr,flash

config FLASH_SIZE
	default $(dt_chosen_reg_size_int,$(DT_CHOSEN_Z_FLASH),0,K)

config FLASH_BASE_ADDRESS
	default $(dt_chosen_reg_addr_hex,$(DT_CHOSEN_Z_FLASH))

endif # SOC_SERIES_RM57LX
```

## soc/ti/hercules/rm57lx/Kconfig.soc
```kconfig
# Texas Instuments Hercules RM57Lx

# Copyright (c) 2024 Rahul Arasikere <arasikere.rahul@gmail.com>
# SPDX-License-Identifier: Apache-2.0

config SOC_SERIES_RM57LX
    bool
    select SOC_FAMILY_TI_HERCULES
    help
      Enable support for TI Hercules RM57Lx SoCs

config SOC_RM57L843ZWT
    bool
    select SOC_SERIES_RM57LX
    help
      RM57L843ZWT

config SOC_SERIES
    default "rm57lx" if SOC_SERIES_RM57LX

config SOC
    default "rm57l843zwt" if SOC_RM57L843ZWT
```
