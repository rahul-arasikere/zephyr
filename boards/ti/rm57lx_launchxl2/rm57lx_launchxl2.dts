/**
 * Copyright (c) 2024 Rahul Arasikere <arasikere.rahul@gmail.com>
 * SPDX-License-Identifier: Apache-2.0
 */

/dts-v1/;

#include <ti/rm57lx.dtsi>

/ {
    model = "TI RM57Lx LaunchXL2";
    compatible = "ti,launchxl2-rm57lx";
};

&oscin {
    status = "okay";
};